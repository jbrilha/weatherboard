## bridge/components/bridge_ota/Kconfig.projbuild
```kconfig
menu "Bridge OTA"

config BRIDGE_OTA_URL
    string "Firmware image URL"
    default "http://pi5.local:8080/firmware.bin"

config BRIDGE_OTA_POLL_S
    int "Seconds between update checks"
    default 300
    range 10 86400

config BRIDGE_OTA_FIRST_CHECK_S
    int "Delay before the first check after boot"
    default 30
    range 0 3600

endmenu
```

## bridge/sdkconfig.defaults
```kconfig
CONFIG_LV_CONF_SKIP=y
CONFIG_LV_COLOR_DEPTH_24=y
CONFIG_LV_FONT_MONTSERRAT_16=y
CONFIG_LV_USE_OBSERVER=y
CONFIG_LV_USE_SYSMON=y
CONFIG_LV_USE_PERF_MONITOR=y
CONFIG_IDF_EXPERIMENTAL_FEATURES=y
CONFIG_COMPILER_OPTIMIZATION_PERF=y
CONFIG_FREERTOS_HZ=1000
CONFIG_LV_DEF_REFR_PERIOD=16
CONFIG_ESP_HOSTED_HOST_FEAT_WIFI=n
CONFIG_ESP_HOSTED_HOST_FEAT_BT=y
CONFIG_BT_ENABLED=y
CONFIG_BT_CONTROLLER_DISABLED=y
CONFIG_BT_NIMBLE_ENABLED=y
CONFIG_BT_NIMBLE_TRANSPORT_UART=n
CONFIG_BT_NIMBLE_42_FEATURE_SUPPORT=y
CONFIG_BT_NIMBLE_50_FEATURE_SUPPORT=y

CONFIG_LV_OS_FREERTOS=y
```
